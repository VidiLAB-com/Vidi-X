/** ESP32 robot tank with wifi and one joystick web control sketch. 

*/

// dodajemo library za ekran 
#include "SPI.h"
#include "Adafruit_GFX.h"
#include "Adafruit_ILI9341.h"

// Za VIDI X ekran ovako trebaju biti deklarirani pinovi.
#define TFT_DC 21
#define TFT_CS 5

// Ovo će kreirati tft objek za korištenje ekrana
Adafruit_ILI9341 tft = Adafruit_ILI9341(TFT_CS, TFT_DC);

#include <ArduinoWebsockets.h>
#include <WiFi.h>
#include <ESPAsyncWebServer.h>

const char* ssid = "VIDI-X_TENKv.1"; //Enter SSID
const char* password = "yourpasswd"; //Enter Password
 
using namespace websockets;
WebsocketsServer server;
AsyncWebServer webserver(80);

int LValue, RValue, commaIndex;

const uint8_t index_html_gz[] = {
0x1f,0x8b,0x08,0x08,0x41,0xdf,0x61,0x5f,0x00,0xff,0x69,0x6e,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0x00

};

// Desni Motor
int IN1 = 13;
int IN2 = 14;

// Lijevi Motor
int IN3 = 32;
int IN4 = 33;

// Treći motor
int IN5 = 2;

// Gumb Start na Vidi X-u
int Btn_Up = 35;


// Inicijalizacija L298N, Motor i pin za kontrolu motora
void Motor_Init(){
  pinMode(IN1, OUTPUT);
  pinMode(IN2, OUTPUT);
  pinMode(IN3, OUTPUT);
  pinMode(IN4, OUTPUT);
  pinMode(IN5, OUTPUT);
  
  pinMode(Btn_Up, INPUT);
}

// Stop function
void Stop(){
  digitalWrite(IN1, LOW);
  digitalWrite(IN2, LOW);
  digitalWrite(IN3, LOW);
  digitalWrite(IN4, LOW);
  Motor_Down();
}

// Back function
void Back(){
  digitalWrite(IN1, LOW);
  digitalWrite(IN2, 1);

  digitalWrite(IN3, LOW);
  digitalWrite(IN4, 1);
}

// Forward function
void Forward(){
  digitalWrite(IN1, 1);
  digitalWrite(IN2, LOW);

  digitalWrite(IN3, 1);
  digitalWrite(IN4, LOW);
}

// Turn  left
void Turn_Left(){
  digitalWrite(IN1, LOW);
  digitalWrite(IN2, 1);

  digitalWrite(IN3, 1);
  digitalWrite(IN4, LOW);
}

// Turn  right
void Turn_Right(){
  digitalWrite(IN1, 1);
  digitalWrite(IN2, LOW);

  digitalWrite(IN3, LOW);
  digitalWrite(IN4, 1);
}

void Motor_Up(){
  for (int n = 0; n < 500; n++){
    digitalWrite(IN5, 1);
  }
  // debug ispisivanje teksta
  tft.setTextColor(random(65535));
  tft.print("Up        ");
}

void Motor_Down(){
  // stisnemo li tipku gore, pomakni motor za gore
  if ( digitalRead(Btn_Up) == HIGH ) {
    Motor_Up();
    tft.setTextColor(random(65535));
    tft.print("Up");
  } else {
    digitalWrite(IN5, LOW);
  
    // debug ispisivanje teksta
    tft.setTextColor(random(65535));
    tft.print("   - Down");
  }
}

void setup()
{
  Serial.begin(115200);

  // postavi zadanje pinove kao output pinove
  Motor_Init();

  // postavi vrijednosti zadanih pinova na LOW ili nulu
  // kako autić nebi nekontrolirano kretao prilikom bootanja
  Stop();

  // iniciajlizira ekran
  tft.begin();
  tft.setRotation(3);
  tft.setTextSize(1);
 
  tft.fillScreen(ILI9341_BLACK);
  tft.setCursor(0, 0);
  tft.setTextColor(ILI9341_YELLOW);
  tft.print("Wi-Fi SSID je: ");
  tft.setTextColor(ILI9341_CYAN);
  tft.println(ssid); // ispisujemo na ekran
  tft.setTextColor(ILI9341_YELLOW);
  tft.print("Password je: ");
  tft.setTextColor(ILI9341_RED);
  tft.println(password); // ispisujemo na ekran

  // Create AP
  WiFi.softAP(ssid, password);
  IPAddress IP = WiFi.softAPIP();

  Serial.print("Internet preglednikom se spoji na IP adresu: ");
  Serial.print(IP);

  tft.setTextColor(ILI9341_YELLOW);
  tft.print("Internet preglednikom se spoji na IP adresu: ");
  tft.setTextColor(ILI9341_BLUE); 
  tft.println(IP); // ispisujemo na ekran

  // HTTP handler assignment
  webserver.on("/", HTTP_GET, [](AsyncWebServerRequest * request) {
    AsyncWebServerResponse *response = request->beginResponse_P(200, "text/html", index_html_gz, sizeof(index_html_gz));
    response->addHeader("Content-Encoding", "gzip");
    request->send(response);
    
  });

  // start server
  webserver.begin();
  server.listen(82);
  Serial.print("Dali je server živ? ");
  Serial.println(server.available());
}
 
// handle http messages
void handle_message(WebsocketsMessage msg) {
  commaIndex = msg.data().indexOf(',');
  
  LValue = msg.data().substring(0, commaIndex).toInt();
  RValue = msg.data().substring(commaIndex + 1).toInt();
  if ((LValue==0) and (RValue==0)) {Stop();}
  if ((LValue>0) and (RValue>0)) {Back();}
  if ((LValue<0) and (RValue<0)) {Forward();}
  if ((LValue>0) and (RValue<=0)) {Turn_Right();}
  if ((LValue<=0) and (RValue>0)) {Turn_Left();}
  
  // debug ispisivanje teksta
  tft.setCursor(0, 100);
  tft.setTextColor(ILI9341_GREEN);
  tft.print(LValue);
  tft.println("; ");
  tft.println(RValue);
  tft.println("       ");
}
 
void loop()
{
  auto client = server.accept();
  client.onMessage(handle_message);
  while (client.available()) {
    client.poll();
  }
}
